## boards/shields/led_indicator/Kconfig.defconfig
```kconfig
if SHIELD_LED_INDICATOR

config LED
    default y

config LED_INDICATOR_BLINK_MS
    int "Duration of blink in ms"
    default 300

config LED_INDICATOR_INTERVAL_MS
    int "Minimum wait duration between two blinks in ms"

config LED_INDICATOR_BATTERY_CRITICAL
    int "Critical battery lever percentage"
    default 7
```

## config/west.yml
```yaml
manifest:
  remotes:
    - name: zmkfirmware
      url-base: https://github.com/zmkfirmware
    - name: englmaxi
      url-base: https://github.com/englmaxi
    # See https://docs.zephyrproject.org/3.2.0/develop/west/manifest.html#projects
  projects:
    - name: zmk
      remote: zmkfirmware
      revision: main
      import: app/west.yml
    - name: zmk-dongle-display
      remote: englmaxi
      revision: main
  self:
    path: config
```
